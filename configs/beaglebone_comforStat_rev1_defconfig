## configs/beaglebone_comforStat_rev1_defconfig
```kconfig
BR2_arm=y
BR2_cortex_a8=y
BR2_ARM_EABIHF=y
BR2_TOOLCHAIN_EXTERNAL=y
BR2_TARGET_GENERIC_HOSTNAME="beaglebone"
BR2_ROOTFS_DEVICE_TABLE="system/device_table.txt board/beaglebone/local-skeleton-permissions.txt"
BR2_TARGET_GENERIC_ROOT_PASSWD="root"
BR2_TARGET_GENERIC_GETTY_PORT="ttyO0"
BR2_ROOTFS_OVERLAY="board/beaglebone/local-skeleton"
BR2_ROOTFS_POST_IMAGE_SCRIPT="board/beaglebone/post-image.sh"
BR2_LINUX_KERNEL=y
BR2_LINUX_KERNEL_CUSTOM_GIT=y
BR2_LINUX_KERNEL_CUSTOM_REPO_URL="git://git.ti.com/ti-linux-kernel/ti-linux-kernel.git"
BR2_LINUX_KERNEL_CUSTOM_REPO_VERSION="ti-linux-3.12.y"
BR2_LINUX_KERNEL_PATCH="board/beaglebone/patches/linux/"
BR2_LINUX_KERNEL_USE_CUSTOM_CONFIG=y
BR2_LINUX_KERNEL_CUSTOM_CONFIG_FILE="board/beaglebone/linux-3.12-comforStat-rev1.config"
BR2_LINUX_KERNEL_ZIMAGE=y
BR2_LINUX_KERNEL_DTS_SUPPORT=y
BR2_LINUX_KERNEL_USE_CUSTOM_DTS=y
BR2_LINUX_KERNEL_CUSTOM_DTS_PATH="board/beaglebone/am335x-boneblack-comfortStatv1.dts board/beaglebone/am335x-boneblack-comfortStatv2.dts"
BR2_PACKAGE_BUSYBOX_SHOW_OTHERS=y
BR2_PACKAGE_GDB=y
BR2_PACKAGE_GDB_DEBUGGER=y
BR2_PACKAGE_GDB_TUI=y
BR2_PACKAGE_OPROFILE=y
BR2_PACKAGE_SPIDEV_TEST=y
BR2_PACKAGE_STRACE=y
BR2_PACKAGE_AM33X_CM3=y
BR2_PACKAGE_LINUX_FIRMWARE=y
BR2_PACKAGE_LINUX_FIRMWARE_RTL_81XX=y
BR2_PACKAGE_DEVMEM2=y
BR2_PACKAGE_I2C_TOOLS=y
BR2_PACKAGE_PYTHON=y
BR2_PACKAGE_PYTHON_ZLIB=y
BR2_PACKAGE_PYTHON_NETIFACES=y
BR2_PACKAGE_PYTHON_PYINOTIFY=y
BR2_PACKAGE_PYTHON_SERIAL=y
BR2_PACKAGE_LIBTIRPC=y
BR2_PACKAGE_DROPBEAR=y
BR2_PACKAGE_DROPBEAR_DISABLE_REVERSEDNS=y
BR2_PACKAGE_GESFTPSERVER=y
BR2_PACKAGE_IW=y
BR2_PACKAGE_SAMBA=y
# BR2_PACKAGE_SAMBA_EVENTLOGADM is not set
# BR2_PACKAGE_SAMBA_NET is not set
# BR2_PACKAGE_SAMBA_NMBD is not set
# BR2_PACKAGE_SAMBA_NMBLOOKUP is not set
# BR2_PACKAGE_SAMBA_NTLM_AUTH is not set
# BR2_PACKAGE_SAMBA_PDBEDIT is not set
# BR2_PACKAGE_SAMBA_PROFILES is not set
# BR2_PACKAGE_SAMBA_RPCCLIENT is not set
# BR2_PACKAGE_SAMBA_SWAT is not set
# BR2_PACKAGE_SAMBA_SMBTAR is not set
# BR2_PACKAGE_SAMBA_TESTPARM is not set
# BR2_PACKAGE_SAMBA_WINBINDD is not set
BR2_PACKAGE_TCPDUMP=y
BR2_PACKAGE_WPA_SUPPLICANT=y
BR2_PACKAGE_WPA_SUPPLICANT_DEBUG_SYSLOG=y
BR2_PACKAGE_WPA_SUPPLICANT_WPS=y
BR2_PACKAGE_WPA_SUPPLICANT_CLI=y
BR2_PACKAGE_WPA_SUPPLICANT_PASSPHRASE=y
BR2_TARGET_ROOTFS_TAR_BZIP2=y
BR2_TARGET_UBOOT=y
BR2_TARGET_UBOOT_BOARDNAME="am335x_evm"
BR2_TARGET_UBOOT_CUSTOM_VERSION=y
BR2_TARGET_UBOOT_CUSTOM_VERSION_VALUE="2013.10"
BR2_TARGET_UBOOT_FORMAT_IMG=y
BR2_TARGET_UBOOT_SPL=y
BR2_TARGET_UBOOT_SPL_NAME="MLO"
BR2_PACKAGE_HOST_E2FSPROGS=y
BR2_PACKAGE_HOST_GENEXT2FS=y
BR2_PACKAGE_HOST_UBOOT_TOOLS=y
```

## configs/patchwork_defconfig
```kconfig
BR2_aarch64=y
BR2_TOOLCHAIN_EXTERNAL=y
BR2_INIT_NONE=y
# BR2_TARGET_ENABLE_ROOT_LOGIN is not set
# BR2_TARGET_GENERIC_GETTY is not set
# BR2_TARGET_GENERIC_REMOUNT_ROOTFS_RW is not set
BR2_LINUX_KERNEL=y
BR2_LINUX_KERNEL_CUSTOM_VERSION=y
BR2_LINUX_KERNEL_CUSTOM_VERSION_VALUE="4.16.7"
BR2_LINUX_KERNEL_USE_CUSTOM_CONFIG=y
BR2_LINUX_KERNEL_CUSTOM_CONFIG_FILE="board/qemu/aarch64-virt/linux.config"
BR2_LINUX_KERNEL_NEEDS_HOST_OPENSSL=y
# BR2_TARGET_ROOTFS_TAR is not set
```

## package/cups-filters/Config.in
```kconfig
config BR2_PACKAGE_CUPS_FILTERS
	bool "cups-filters"
	depends on BR2_PACKAGE_CUPS
	select BR2_PACKAGE_LIBGLIB2
	select BR2_PACKAGE_IJS
	select BR2_PACKAGE_LCMS2
	select BR2_PACKAGE_POPPLER
	select BR2_PACKAGE_QPDF
	# needs fork()
	depends on BR2_USE_MMU
	depends on BR2_PACKAGE_LIBGLIB2
	depends on BR2_PACKAGE_IJS
	depends on BR2_PACKAGE_LCMS2
	depends on BR2_PACKAGE_POPPLER
	depends on BR2_PACKAGE_QPDF
	help
	  This project provides backends, filters, and other software that was
	  once part of the core CUPS distribution but is no longer maintained
	  by Apple Inc. In addition it contains additional filters and software
	  developed independently of Apple, especially filters for the PDF-
	  centric printing workflow introduced by OpenPrinting and a daemon
	  to browse Bonjour broadcasts of remote CUPS printers to make these
	  printers available locally and to provide backward compatibility to
	  the old CUPS broadcasting and browsing of CUPS 1.5.x and older.
	  From CUPS 1.6.0 on, this package is required for using printer drivers
	  with CUPS under Linux. With CUPS 1.5.x and earlier this package can be
	  used optionally to switch over to PDF-based printing.

	  http://www.linuxfoundation.org/collaborate/workgroups/openprinting/cups-filters

comment "cups-filters depends on libglib2"
	depends on !BR2_PACKAGE_LIBGLIB2

comment "cups-filters depends on ijs"
	depends on !BR2_PACKAGE_IJS

comment "cups-filters depends on lcms2"
	depends on !BR2_PACKAGE_LCMS2

comment "cups-filters depends on poppler"
	depends on !BR2_PACKAGE_POPPLER

comment "cups-filters depends on qpdf"
	depends on !BR2_PACKAGE_QPDF

if BR2_PACKAGE_CUPS_FILTERS

config BR2_PACKAGE_CUPS_FILTERS_PDFTOPS
	bool "pdftops support"
	depends on BR2_INSTALL_LIBSTDCPP
	help
	  Enable pdftops support

comment "pdftops support needs a toolchain w/ C++"
	depends on !BR2_INSTALL_LIBSTDCPP

endif
```

## package/cups/Config.in
```kconfig
config BR2_PACKAGE_CUPS
	bool "cups"
	# needs libstdcpp for ppdc
	depends on BR2_INSTALL_LIBSTDCPP
	# needs fork()
	depends on BR2_USE_MMU
	help
	  The Common Unix Printing System

	  http://www.cups.org

if BR2_PACKAGE_CUPS

config BR2_PACKAGE_CUPS_PDFTOPS
	bool "pdftops support"
	depends on BR2_DEPRECATED_SINCE_2015_05

config BR2_PACKAGE_CUPS_AVAHI
	bool "avahi support"
	depends on !BR2_STATIC_LIBS # avahi
	depends on !BR2_TOOLCHAIN_HAS_THREADS # avahi
	select BR2_PACKAGE_AVAHI
	select BR2_PACKAGE_AVAHI_DAEMON
	help
	  Enable Avahi support.
	  Select this if you want cups to support Bonjour protocol.

endif
```

## package/python-argparse/Config.in
```kconfig
config BR2_PACKAGE_PYTHON_ARGPARSE
	bool "python-argparse"
	depends on BR2_PACKAGE_PYTHON
	help
	  The argparse module makes it easy to
	  write user friendly command line interfaces.

	  https://pypi.python.org/pypi/argparse
```

## package/python-cloudprint/Config.in
```kconfig
config BR2_PACKAGE_PYTHON_CLOUDPRINT
	bool "python-cloudprint"
	depends on BR2_PACKAGE_PYTHON
	depends on BR2_PACKAGE_CUPS
	depends on BR2_PACKAGE_CUPS_FILTERS
	select BR2_PACKAGE_PYTHON_PYCUPS
	select BR2_PACKAGE_PYTHON_DAEMON
	select BR2_PACKAGE_PYTHON_REQUESTS
	select BR2_PACKAGE_PYTHON_SETUPTOOLS
	select BR2_PACKAGE_PYTHON_ARGPARSE
	help
	  This software is a python implementation of a
	  cloud print connector. Unlike Google's linux
	  connector, it does not require chrome to be
	  installed on the server.

	  https://github.com/armooo/cloudprint

comment "python-cloudprint depends on python"
        depends on !BR2_PACKAGE_PYTHON

comment "python-cloudprint depends on cups"
        depends on !BR2_PACKAGE_CUPS

comment "python-cloudprint depends on cups-filter"
        depends on !BR2_PACKAGE_CUPS_FILTERS
```

## package/python-pycups/Config.in
```kconfig
config BR2_PACKAGE_PYTHON_PYCUPS
	bool "python-pycups"
	depends on BR2_PACKAGE_PYTHON
	help
	  This is a set of Python bindings for the libcups library.

	  http://cyberelk.net/tim/software/pycups/
```
